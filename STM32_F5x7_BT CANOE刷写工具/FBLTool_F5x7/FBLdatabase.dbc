VERSION ""

NS_ :

BS_:

BU_:
VAL_TABLE_ Vt_Env_DownFileNum 2 "2" 1 "1" 0 "0" ;
VAL_TABLE_ TRANSUNIT 1 "128" 0 "256" ;
VAL_TABLE_ ECUNAME 2 "BMU" 1 "BCU" 0 "VCU" ;

BO_ 3221225472 VECTOR__INDEPENDENT_SIG_MSG: 0 Vector__XXX
 SG_ diagSign2 : 0|8@0+ (1,0) [0|0] "" Vector__XXX
 SG_ diagSign1 : 0|8@0+ (1,0) [0|0] "" Vector__XXX
 SG_ CRCValue : 0|32@1+ (1,0) [0|0] "" Vector__XXX

BO_ 1816 DiagResp: 8 Vector__XXX

BO_ 2015 DiagFUN: 8 Vector__XXX

BO_ 1808 DiagPHY: 8 Vector__XXX

EV_ enVar_FingerPrintInfo: 0 [0|0] "" 0 1 DUMMY_NODE_VECTOR3 Vector__XXX;

EV_ enVar_GetLocalTimeButton: 0 [0|255] "" 0 2 DUMMY_NODE_VECTOR0 Vector__XXX;

EV_ evVar_Lcd: 1 [0|65565] "" 0 3 DUMMY_NODE_VECTOR3 Vector__XXX;

EV_ enVar_InfoText: 0 [0|0] "" 0 4 DUMMY_NODE_VECTOR8000 Vector__XXX;

EV_ enVar_OutpputCRC: 0 [0|0] "" 0 5 DUMMY_NODE_VECTOR3 Vector__XXX;

EV_ enVar_CalculateCrcButton: 0 [0|255] "" 0 6 DUMMY_NODE_VECTOR0 Vector__XXX;

EV_ enVar_FileCrcCal: 0 [0|255] "" 0 7 DUMMY_NODE_VECTOR8000 Vector__XXX;

EV_ enVar_StopButten: 0 [0|255] "" 0 8 DUMMY_NODE_VECTOR0 Vector__XXX;

EV_ evVar_Progress_Bar: 0 [0|100] "" 0 9 DUMMY_NODE_VECTOR3 Vector__XXX;

EV_ enVar_CheckDrvFile0: 0 [0|255] "" 0 10 DUMMY_NODE_VECTOR0 Vector__XXX;

EV_ enVar_CheckDataFile1: 0 [0|255] "" 0 11 DUMMY_NODE_VECTOR0 Vector__XXX;

EV_ enVar_DataFile1: 0 [0|255] "" 0 12 DUMMY_NODE_VECTOR8000 Vector__XXX;

EV_ enVar_DataFile0: 0 [0|255] "" 0 13 DUMMY_NODE_VECTOR8000 Vector__XXX;

EV_ enVar_StartButten: 0 [0|255] "" 0 14 DUMMY_NODE_VECTOR0 Vector__XXX;

EV_ enVar_DrvFile0: 0 [0|255] "" 0 15 DUMMY_NODE_VECTOR8000 Vector__XXX;

EV_ enVar_CheckDataFile0: 0 [0|255] "" 0 16 DUMMY_NODE_VECTOR0 Vector__XXX;
ENVVAR_DATA_ enVar_FingerPrintInfo: 4;
ENVVAR_DATA_ enVar_OutpputCRC: 4;

CM_ BO_ 3221225472 "This is a message for not used signals, created by Vector CANdb++ DBC OLE DB Provider.";
